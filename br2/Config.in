## br2/Config.in
```kconfig
source "$BR2_EXTERNAL_FDPP_PATH/package/dosemu2/Config.in"
source "$BR2_EXTERNAL_FDPP_PATH/package/fdpp/Config.in"
source "$BR2_EXTERNAL_FDPP_PATH/package/comcom64/Config.in"
source "$BR2_EXTERNAL_FDPP_PATH/package/thunk_gen/Config.in"
```

## br2/configs/fdpp_pc_x86_64_efi_defconfig
```kconfig
BR2_x86_64=y
BR2_x86_opteron=y
BR2_GCC_VERSION_13_X=y
BR2_TOOLCHAIN_BUILDROOT_CXX=y
BR2_WGET="wget -nd -t 3"
BR2_BACKUP_SITE="http://sources.buildroot.net"
BR2_CPAN_MIRROR="http://cpan.metacpan.org"
BR2_JLEVEL=10
BR2_CCACHE=y
BR2_OPTIMIZE_S=y
BR2_PACKAGE_OVERRIDE_FILE="$(BR2_EXTERNAL_FDPP_PATH)/local.mk"
BR2_GLOBAL_PATCH_DIR="$(BR2_EXTERNAL_FDPP_PATH)/patches"
BR2_RELRO_NONE=y
BR2_ROOTFS_DEVICE_CREATION_DYNAMIC_EUDEV=y
BR2_ROOTFS_MERGED_USR=y
BR2_TARGET_GENERIC_GETTY_PORT="tty1"
BR2_SYSTEM_DEFAULT_PATH="/bin:/sbin:/usr/bin:/usr/sbin"
BR2_ROOTFS_POST_BUILD_SCRIPT="board/pc/post-build.sh $(BR2_EXTERNAL_FDPP_PATH)/board/pc-x86_64-uefi/post-build.sh"
BR2_ROOTFS_POST_IMAGE_SCRIPT="$(BR2_EXTERNAL_FDPP_PATH)/board/pc-x86_64-uefi/post-image-efi.sh"
BR2_LINUX_KERNEL=y
BR2_LINUX_KERNEL_USE_CUSTOM_CONFIG=y
BR2_LINUX_KERNEL_CUSTOM_CONFIG_FILE="$(BR2_EXTERNAL_FDPP_PATH)/board/pc-x86_64-uefi/linux.config"
BR2_LINUX_KERNEL_INSTALL_TARGET=y
BR2_PACKAGE_BUSYBOX_CONFIG="$(BR2_EXTERNAL_FDPP_PATH)/board/pc-x86_64-uefi/busybox.config"
BR2_PACKAGE_GDB=y
BR2_PACKAGE_GDB_DEBUGGER=y
BR2_PACKAGE_GDB_TUI=y
BR2_PACKAGE_STRACE=y
BR2_PACKAGE_KMSCUBE=y
BR2_PACKAGE_MESA3D=y
BR2_PACKAGE_MESA3D_GALLIUM_DRIVER_SWRAST=y
BR2_PACKAGE_MESA3D_GALLIUM_DRIVER_VIRGL=y
BR2_PACKAGE_MESA3D_OPENGL_ES=y
BR2_PACKAGE_SDL2_KMSDRM=y
BR2_PACKAGE_SDL2_OPENGLES=y
BR2_PACKAGE_LINUX_FIRMWARE=y
BR2_PACKAGE_LINUX_FIRMWARE_ATHEROS_9170=y
BR2_PACKAGE_LINUX_FIRMWARE_ATHEROS_9271=y
BR2_PACKAGE_LINUX_FIRMWARE_IWLWIFI_3160=y
BR2_PACKAGE_LINUX_FIRMWARE_IWLWIFI_3168=y
BR2_PACKAGE_LINUX_FIRMWARE_IWLWIFI_5000=y
BR2_PACKAGE_LINUX_FIRMWARE_IWLWIFI_6000G2A=y
BR2_PACKAGE_LINUX_FIRMWARE_IWLWIFI_6000G2B=y
BR2_PACKAGE_LINUX_FIRMWARE_IWLWIFI_7260=y
BR2_PACKAGE_LINUX_FIRMWARE_IWLWIFI_7265D=y
BR2_PACKAGE_LINUX_FIRMWARE_IWLWIFI_8000C=y
BR2_PACKAGE_LINUX_FIRMWARE_IWLWIFI_8265=y
BR2_PACKAGE_LINUX_FIRMWARE_RALINK_RT73=y
BR2_PACKAGE_LINUX_FIRMWARE_RALINK_RT2XX=y
BR2_PACKAGE_LINUX_FIRMWARE_RTL_81XX=y
BR2_PACKAGE_LINUX_FIRMWARE_RTL_87XX=y
BR2_PACKAGE_LINUX_FIRMWARE_RTL_88XX=y
BR2_PACKAGE_LINUX_FIRMWARE_RTL_8169=y
BR2_PACKAGE_ACPID=y
BR2_PACKAGE_GPM_INSTALL_TEST_TOOLS=y
BR2_PACKAGE_KBD=y
BR2_PACKAGE_LIBXKBCOMMON=y
BR2_PACKAGE_MTDEV=y
BR2_PACKAGE_SLIRP=y
BR2_PACKAGE_LIBEVDEV=y
BR2_PACKAGE_PCRE=y
BR2_PACKAGE_PCRE_UCP=y
BR2_PACKAGE_IFUPDOWN=y
BR2_PACKAGE_IPTABLES=y
BR2_PACKAGE_WPA_SUPPLICANT=y
BR2_PACKAGE_WPA_SUPPLICANT_DBUS=y
# BR2_PACKAGE_URANDOM_SCRIPTS is not set
BR2_PACKAGE_FILE=y
BR2_PACKAGE_COREUTILS=y
BR2_PACKAGE_UTIL_LINUX_BINARIES=y
BR2_PACKAGE_UTIL_LINUX_IPCMK=y
BR2_PACKAGE_UTIL_LINUX_IPCRM=y
BR2_PACKAGE_UTIL_LINUX_IPCS=y
BR2_PACKAGE_UTIL_LINUX_MOUNT=y
BR2_TARGET_ROOTFS_EXT2=y
BR2_TARGET_ROOTFS_EXT2_4=y
BR2_TARGET_ROOTFS_EXT2_SIZE="350M"
# BR2_TARGET_ROOTFS_TAR is not set
BR2_TARGET_GRUB2=y
BR2_TARGET_GRUB2_X86_64_EFI=y
BR2_TARGET_GRUB2_INSTALL_TOOLS=y
BR2_PACKAGE_HOST_DOSFSTOOLS=y
BR2_PACKAGE_HOST_GENEXT2FS=y
BR2_PACKAGE_HOST_GENIMAGE=y
BR2_PACKAGE_HOST_MTOOLS=y
BR2_PACKAGE_DOSEMU2=y
BR2_PACKAGE_FDPP=y
BR2_PACKAGE_COMCOM32=y
```

## br2/package/comcom32/Config.in
```kconfig
config BR2_PACKAGE_COMCOM32
    bool "comcom32"
    help
      32bit command.com
```

## br2/package/comcom64/Config.in
```kconfig
config BR2_PACKAGE_COMCOM64
    bool "comcom64"
    help
      64bit command.com
```

## br2/package/dj64dev/Config.in
```kconfig
config BR2_PACKAGE_DJ64DEV
    bool "dj64dev"
    select BR2_PACKAGE_ELFUTILS
    select BR2_PACKAGE_THUNK_GEN
    select BR2_PACKAGE_CTAGS
    help
      dj64dev.
```

## br2/package/dosemu2/Config.in
```kconfig
config BR2_PACKAGE_DOSEMU2
    bool "dosemu2"
    depends on BR2_i386 || BR2_x86_64
    depends on BR2_PACKAGE_FDPP
    depends on BR2_PACKAGE_COMCOM32
    select BR2_PACKAGE_BUSYBOX_SHOW_OTHERS
    select BR2_PACKAGE_BASH
    select BR2_PACKAGE_SUDO
    select BR2_PACKAGE_JSON_C
    select BR2_PACKAGE_SLANG
    select BR2_PACKAGE_LIBBSD
    select BR2_PACKAGE_LIBAO
    select BR2_PACKAGE_ALSA_LIB
    select BR2_PACKAGE_FLUIDSYNTH
    select BR2_PACKAGE_FLUID_SOUNDFONT
    select BR2_PACKAGE_GPM
    select BR2_PACKAGE_READLINE
    select BR2_PACKAGE_SDL2
    select BR2_PACKAGE_SDL2_KMSDRM
    select BR2_PACKAGE_SDL2_TTF
    select BR2_PACKAGE_FONTCONFIG
    select BR2_PACKAGE_LIBDRM
    select BR2_PACKAGE_GLIBC_UTILS
    help
      dosemu2 is a virtual machine that allows you to run DOS
      programs under linux.
```

## br2/package/fdpp/Config.in
```kconfig
config BR2_PACKAGE_FDPP
    bool "fdpp"
    depends on BR2_INSTALL_LIBSTDCPP
    select BR2_PACKAGE_ELFUTILS
    select BR2_PACKAGE_THUNK_GEN
    help
      freedos++.
```

## br2/package/thunk_gen/Config.in
```kconfig
config BR2_PACKAGE_THUNK_GEN
    bool "thunk_gen"
    select BR2_PACKAGE_FLEX
    select BR2_PACKAGE_BISON
    select BR2_PACKAGE_AUTOCONF
    help
      thunk-gen.
```
